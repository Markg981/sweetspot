## Config.in
```kconfig
source "$BR2_EXTERNAL_SWEETSPOT_PATH/package/lms/Config.in"
source "$BR2_EXTERNAL_SWEETSPOT_PATH/package/lms-material/Config.in"
source "$BR2_EXTERNAL_SWEETSPOT_PATH/package/sweetspot-tools/Config.in"
source "$BR2_EXTERNAL_SWEETSPOT_PATH/package/camilladsp/Config.in"
source "$BR2_EXTERNAL_SWEETSPOT_PATH/package/alsa-cdsp/Config.in"
```

## package/alsa-cdsp/Config.in
```kconfig
config BR2_PACKAGE_ALSA_CDSP
	bool "alsa-cdsp"
	select BR2_PACKAGE_ALSA_LIB
	select BR2_PACKAGE_ALSA_LIB_PCM
	help
	  Plugin ALSA che passa l'audio a CamillaDSP. Con la patch di
	  Sweetspot lavora su un'unica istanza della sessione (pipe) e a
	  ogni cambio di frequenza le fa caricare la configurazione
	  giusta dal websocket, senza riavviarla.

	  https://github.com/scripple/alsa_cdsp
```

## package/camilladsp/Config.in
```kconfig
config BR2_PACKAGE_CAMILLADSP
	bool "camilladsp"
	depends on BR2_PACKAGE_HOST_RUSTC_TARGET_ARCH_SUPPORTS
	select BR2_PACKAGE_HOST_RUSTC
	select BR2_PACKAGE_ALSA_LIB
	help
	  CamillaDSP: elaborazione audio (filtri, correzione ambientale)
	  per la correzione con i filtri misurati con REW.

	  https://github.com/HEnquist/camilladsp
```

## package/lms-material/Config.in
```kconfig
config BR2_PACKAGE_LMS_MATERIAL
	bool "lms-material"
	depends on BR2_PACKAGE_LMS
	help
	  Material Skin: interfaccia web moderna per Lyrion Music Server,
	  comoda da telefono, tablet e computer. Sweetspot la installa
	  al primo avvio come plugin di Lyrion, cosi' si aggiorna dal
	  gestore dei plugin.

	  https://github.com/CDrummond/lms-material
```

## package/lms/Config.in
```kconfig
config BR2_PACKAGE_LMS
	bool "lms"
	depends on BR2_x86_64 # moduli Perl compilati inclusi solo per x86_64 con Perl 5.42
	depends on BR2_USE_MMU # perl
	depends on BR2_TOOLCHAIN_HAS_THREADS
	depends on BR2_TOOLCHAIN_USES_GLIBC # moduli compilati per glibc
	depends on !BR2_STATIC_LIBS
	select BR2_PACKAGE_PERL
	select BR2_PACKAGE_PERL_THREADS
	select BR2_PACKAGE_PERL_NET_SSLEAY
	select BR2_PACKAGE_PERL_IO_SOCKET_SSL
	select BR2_PACKAGE_CA_CERTIFICATES
	help
	  Lyrion Music Server (in passato Logitech Media Server): la
	  libreria musicale, i plugin (Spotify, Qobuz, TIDAL, radio,
	  UPnP, AirPlay...) e il controllo dei player Squeezebox e
	  Squeezelite. E' lo stesso motore usato da Daphile.

	  https://lyrion.org/

comment "lms needs an x86_64 glibc toolchain with threads"
	depends on !BR2_x86_64 || !BR2_TOOLCHAIN_USES_GLIBC || !BR2_TOOLCHAIN_HAS_THREADS
```

## package/mympd/Config.in
```kconfig
config BR2_PACKAGE_MYMPD
	bool "mympd"
	depends on BR2_TOOLCHAIN_HAS_THREADS
	depends on BR2_USE_MMU
	depends on !BR2_STATIC_LIBS
	select BR2_PACKAGE_OPENSSL
	select BR2_PACKAGE_PCRE2
	select BR2_PACKAGE_FLAC
	select BR2_PACKAGE_LIBID3TAG
	select BR2_PACKAGE_UTF8PROC
	help
	  myMPD: interfaccia web per MPD, utilizzabile da browser su
	  computer, tablet e telefono (anche come app installata).

	  https://jcorporation.github.io/myMPD/
```

## package/sweetspot-rpi-firmware/Config.in
```kconfig
config BR2_PACKAGE_SWEETSPOT_RPI_FIRMWARE
	bool "sweetspot-rpi-firmware"
	depends on BR2_aarch64
	depends on BR2_LINUX_KERNEL
	depends on BR2_LINUX_KERNEL_DTS_SUPPORT
	select BR2_LINUX_KERNEL_DTB_OVERLAY_SUPPORT
	help
	  Avvio del Raspberry Pi 4 e 5 per Sweetspot: firmware del Pi 4
	  (start4.elf, fixup4.dat) dall'ultima release della Raspberry Pi
	  Foundation e overlay compilati dal kernel in uso (tutti, per le
	  schede DAC I2S scelte dalla pagina Audio). Sostituisce
	  rpi-firmware di Buildroot, fissato a una versione meno recente.

	  https://github.com/raspberrypi/firmware
```

## package/sweetspot-tools/Config.in
```kconfig
config BR2_PACKAGE_SWEETSPOT_TOOLS
	bool "sweetspot-tools"
	select BR2_PACKAGE_FREETYPE
	select BR2_PACKAGE_LIBQRENCODE
	help
	  Programmi di Sweetspot scritti in C: firme AccurateRip per
	  la verifica delle copie dei CD (sweetspot-arcrc), schermata
	  di benvenuto sul monitor (sweetspot-schermo).

	  https://github.com/Markg981/sweetspot
```
